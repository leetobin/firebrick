## extraFiles/package/cryptsetup/Config.in
```kconfig
config BR2_PACKAGE_CRYPTSETUP
	bool "cryptsetup"
	help
		Setup virtual encryption devices under dm-crypt Linux

		https://code.google.com/p/cryptsetup/
```

## extraFiles/package/libewf/Config.in
```kconfig
config BR2_PACKAGE_LIBEWF
	bool "libewf"
	help
          Libewf is a library to access the Expert Witness Compression Format (EWF).

          https://code.google.com/p/libewf/
```
